## boards/shields/lism/Kconfig.defconfig
```kconfig
if SHIELD_LISM_L || SHIELD_LISM_R
    config ZMK_KEYBOARD_NAME
        default "LisM"

    config NFCT_PINS_AS_GPIOS
        default y

    config ZMK_SPLIT
        default y

    config ZMK_POINTING
        default y

    config ZMK_MOUSE
        default y
    
    config PAW3222
        default y
    
    config INPUT
        default y
    
    config SPI
        default y
endif
```

## boards/shields/lism/Kconfig.shield
```kconfig
# No whitespace after the comma or in your keyboard name!
config SHIELD_LISM_R
    def_bool $(shields_list_contains,lism_right)

config SHIELD_LISM_L
    def_bool $(shields_list_contains,lism_left)
```

## config/west.yml
```yaml
manifest:
  remotes:
    - name: zmkfirmware
      url-base: https://github.com/zmkfirmware
    - name: sekigon-gonnoc
      url-base: https://github.com/sekigon-gonnoc
    - name: caksoylar
      url-base: https://github.com/caksoylar
    - name: 4mplelab
      url-base: https://github.com/4mplelab
    - name: cormoran
      url-base: https://github.com/cormoran
  projects:
    - name: zmk
      remote: cormoran
      revision: v0.3-branch+dya
      import: app/west.yml
    - name: zmk-driver-paw3222
      remote: sekigon-gonnoc
      revision: main
    - name: zmk-rgbled-widget
      remote: caksoylar
      revision: main
    - name: zmk-feature-charge-indicator
      remote: 4mplelab
      revision: main

    - name: zmk-module-ble-management
      remote: cormoran
      revision: main
    - name: zmk-module-battery-history
      remote: cormoran
      revision: main
    - name: zmk-module-settings-rpc
      remote: cormoran
      revision: main
    - name: zmk-module-runtime-input-processor
      remote: cormoran
      revision: main
    - name: zmk-behavior-runtime-sensor-rotate
      remote: cormoran
      revision: main
  self:
    path: config
```
